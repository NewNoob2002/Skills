## CMakeLists.txt
```
# SPDX-License-Identifier: Apache-2.0
cmake_minimum_required(VERSION 3.20.0)
find_package(Zephyr REQUIRED HINTS $ENV{ZEPHYR_BASE})
project(frame_app)

target_include_directories(app PRIVATE include)
target_sources(app PRIVATE src/main.c src/frame_parser.c)
```

## sample.yaml
```
sample:
  name: frame parser application
tests:
  app.frame.build:
    build_only: true
    platform_allow:
      - native_sim/native/64
    integration_platforms:
      - native_sim/native/64
```

## prj.conf
```kconfig
CONFIG_LOG=y
# console 设备（native_sim 上为 native PTY UART）需要串口驱动，否则 DEVICE_DT_GET 链接失败
CONFIG_SERIAL=y
```

## src/main.c
```c
/*
 * SPDX-License-Identifier: Apache-2.0
 */

#include <errno.h>

#include <zephyr/device.h>
#include <zephyr/kernel.h>
#include <zephyr/logging/log.h>

#include <app/frame_parser.h>

LOG_MODULE_REGISTER(frame_app, LOG_LEVEL_INF);

static const struct device *const console = DEVICE_DT_GET(DT_CHOSEN(zephyr_console));

static const uint8_t demo_frame[] = {FRAME_START, 2U, 0x10U, 0x20U, 0x32U};

int main(void)
{
	struct frame frame;
	int ret;

	if (!device_is_ready(console)) {
		LOG_ERR("console device not ready");
		return -ENODEV;
	}

	ret = frame_parse(demo_frame, sizeof(demo_frame), &frame);
	if (ret < 0) {
		LOG_ERR("parse failed: %d", ret);
		return ret;
	}

	LOG_INF("frame with %u payload bytes", frame.len);

	return 0;
}
```

## src/frame_parser.c
```c
/*
 * SPDX-License-Identifier: Apache-2.0
 */

#include <errno.h>
#include <string.h>

#include <app/frame_parser.h>

int frame_parse(const uint8_t *buf, size_t size, struct frame *out)
{
	uint8_t sum;
	uint8_t len;

	if ((buf == NULL) || (out == NULL) || (size < 1U) || (buf[0] != FRAME_START)) {
		return -EINVAL;
	}

	if (size < 2U) {
		return -EAGAIN;
	}

	len = buf[1];
	/* Validate the length field before touching the payload (PROTO-001). */
	if (len > FRAME_MAX_PAYLOAD) {
		return -EMSGSIZE;
	}

	if (size < ((size_t)len + 3U)) {
		return -EAGAIN;
	}

	sum = len;
	for (size_t i = 0; i < len; i++) {
		sum = (uint8_t)(sum + buf[2U + i]);
	}

	if (sum != buf[2U + len]) {
		return -EBADMSG;
	}

	out->len = len;
	memcpy(out->payload, &buf[2], len);

	return 0;
}
```
